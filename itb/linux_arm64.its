## itb/linux_arm64.its
```
/*
 * Copyright 2017 NXP
 *
 */


/dts-v1/;

/ {
	description = "arm64 kernel, ramdisk and FDT blob";
	#address-cells = <1>;

	images {
		kernel {
			description = "ARM64 Kernel";
			data = /incbin/("./Image.gz");
			type = "kernel";
			arch = "arm64";
			os = "linux";
			compression = "gzip";
			load = <0x80080000>;
			entry = <0x80080000>;
			hash@1 {
				algo = "crc32";
			};
		};

		initrd {
			description = "initrd for arm64";
			data = /incbin/("./ramdisk_rootfs_arm64.ext4.gz");
			type = "ramdisk";
			arch = "arm64";
			os = "linux";
			compression = "none";
			load = <0x00000000>;
			entry = <0x00000000>;
			hash@1 {
				algo = "crc32";
			};
		};		

		ls1043ardb-dtb {
			description = "ls1043ardb-dtb";
			data = /incbin/("./fsl-ls1043a-rdb-sdk.dtb");
			type = "flat_dt";
			arch = "arm64";
			os = "linux";
			compression = "none";
			load = <0x90000000>;
			hash@1 {
				algo = "crc32";
			};
		};		
	};

	configurations {
		
		ls1043ardb {
			description = "config for ls1043ardb";
			kernel = "kernel";
			ramdisk = "initrd";
			fdt = "ls1043ardb-dtb";
		};		
	};
};
```
